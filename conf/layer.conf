## conf/layer.conf
```bitbake
# We have a conf and classes directory, add to BBPATH
BBPATH .= ":${LAYERDIR}"

# We have recipes-* directories, add to BBFILES
BBFILES += "${LAYERDIR}/recipes-*/*/*.bb \
            ${LAYERDIR}/recipes-*/*/*.bbappend"

BBFILE_COLLECTIONS += "meta-imx8mp-framos"
BBFILE_PATTERN_meta-imx8mp-framos = "^${LAYERDIR}/"
BBFILE_PRIORITY_meta-imx8mp-framos = "9"

LAYERDEPENDS_meta-imx8mp-framos = "core"
LAYERSERIES_COMPAT_meta-imx8mp-framos = "nanbield"

KERNEL_DEVICETREE:append:imx8mp-lpddr4-evk = " \
	freescale/imx8mp-evk-imx662.dtb \
	freescale/imx8mp-evk-imx662-dual.dtb \
	freescale/imx8mp-evk-imx662-gmsl.dtb \
	freescale/imx8mp-evk-imx662-dual-gmsl.dtb \
	freescale/imx8mp-evk-imx676.dtb \
	freescale/imx8mp-evk-imx676-dual.dtb \
	freescale/imx8mp-evk-imx676-gmsl.dtb \
	freescale/imx8mp-evk-imx676-dual-gmsl.dtb \
	freescale/imx8mp-evk-imx678.dtb \
	freescale/imx8mp-evk-imx678-dual.dtb \
	freescale/imx8mp-evk-imx678-gmsl.dtb \
	freescale/imx8mp-evk-imx678-dual-gmsl.dtb \
	freescale/imx8mp-evk-imx900.dtb \
	freescale/imx8mp-evk-imx900-dual.dtb \
	freescale/imx8mp-evk-imx900-gmsl.dtb \
	freescale/imx8mp-evk-imx900-dual-gmsl.dtb \
"
```
